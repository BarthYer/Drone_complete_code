## build/Kconfig/arch/Kconfig
```kconfig
# Load Zephyr Arch Kconfig descriptions.
osource "/home/barth/zephyrproject/zephyr/arch/rx/Kconfig"
osource "/home/barth/zephyrproject/zephyr/arch/x86/Kconfig"
osource "/home/barth/zephyrproject/zephyr/arch/xtensa/Kconfig"
osource "/home/barth/zephyrproject/zephyr/arch/sparc/Kconfig"
osource "/home/barth/zephyrproject/zephyr/arch/riscv/Kconfig"
osource "/home/barth/zephyrproject/zephyr/arch/posix/Kconfig"
osource "/home/barth/zephyrproject/zephyr/arch/mips/Kconfig"
osource "/home/barth/zephyrproject/zephyr/arch/arm64/Kconfig"
osource "/home/barth/zephyrproject/zephyr/arch/arm/Kconfig"
osource "/home/barth/zephyrproject/zephyr/arch/arc/Kconfig"
```

## build/Kconfig/boards/Kconfig
```kconfig
# Load Zephyr board Kconfig descriptions.
osource "/home/barth/zephyrproject/zephyr/boards/espressif/esp32s3_devkitc/Kconfig"
```

## build/Kconfig/boards/Kconfig.defconfig
```kconfig
# Load Zephyr board defconfig descriptions.
osource "/home/barth/zephyrproject/zephyr/boards/espressif/esp32s3_devkitc/Kconfig.defconfig"
```

## build/Kconfig/boards/Kconfig.esp32s3_devkitc
```kconfig
# Load board Kconfig descriptions.
osource "/home/barth/zephyrproject/zephyr/boards/espressif/esp32s3_devkitc/Kconfig.esp32s3_devkitc"
```

## build/Kconfig/boards/Kconfig.sysbuild
```kconfig
# Load Sysbuild board Kconfig descriptions.
osource "/home/barth/zephyrproject/zephyr/boards/espressif/esp32s3_devkitc/Kconfig.sysbuild"
```

## build/Kconfig/soc/Kconfig
```kconfig
# Load Zephyr SoC Kconfig descriptions.
osource "/home/barth/zephyrproject/zephyr/soc/xlnx/zynqmp/Kconfig"
osource "/home/barth/zephyrproject/zephyr/soc/xlnx/zynq7000/Kconfig"
osource "/home/barth/zephyrproject/zephyr/soc/xlnx/versalnet/Kconfig"
osource "/home/barth/zephyrproject/zephyr/soc/xlnx/versal2/Kconfig"
osource "/home/barth/zephyrproject/zephyr/soc/xlnx/versal/Kconfig"
osource "/home/barth/zephyrproject/zephyr/soc/xen/Kconfig"
osource "/home/barth/zephyrproject/zephyr/soc/wch/ch32v/Kconfig"
osource "/home/barth/zephyrproject/zephyr/soc/ti/simplelink/Kconfig"
osource "/home/barth/zephyrproject/zephyr/soc/ti/mspm0/Kconfig"
osource "/home/barth/zephyrproject/zephyr/soc/ti/lm3s6965/Kconfig"
osource "/home/barth/zephyrproject/zephyr/soc/ti/k3/Kconfig"
osource "/home/barth/zephyrproject/zephyr/soc/telink/tlsr/Kconfig"
osource "/home/barth/zephyrproject/zephyr/soc/starfive/jh71xx/Kconfig"
osource "/home/barth/zephyrproject/zephyr/soc/st/stm32/Kconfig"
osource "/home/barth/zephyrproject/zephyr/soc/snps/qemu_arc/Kconfig"
osource "/home/barth/zephyrproject/zephyr/soc/snps/nsim/arc_v/Kconfig"
osource "/home/barth/zephyrproject/zephyr/soc/snps/nsim/arc_classic/Kconfig"
osource "/home/barth/zephyrproject/zephyr/soc/snps/hsdk4xd/Kconfig"
osource "/home/barth/zephyrproject/zephyr/soc/snps/hsdk/Kconfig"
osource "/home/barth/zephyrproject/zephyr/soc/snps/emsk/Kconfig"
osource "/home/barth/zephyrproject/zephyr/soc/snps/emsdp/Kconfig"
osource "/home/barth/zephyrproject/zephyr/soc/snps/arc_iot/Kconfig"
osource "/home/barth/zephyrproject/zephyr/soc/silabs/Kconfig"
osource "/home/barth/zephyrproject/zephyr/soc/sifli/sf32/Kconfig"
osource "/home/barth/zephyrproject/zephyr/soc/sifive/sifive_freedom/Kconfig"
osource "/home/barth/zephyrproject/zephyr/soc/sensry/Kconfig"
osource "/home/barth/zephyrproject/zephyr/soc/rockchip/Kconfig"
osource "/home/barth/zephyrproject/zephyr/soc/renode/riscv_virtual/Kconfig"
osource "/home/barth/zephyrproject/zephyr/soc/renode/cortex_r8_virtual/Kconfig"
osource "/home/barth/zephyrproject/zephyr/soc/renesas/smartbond/Kconfig"
osource "/home/barth/zephyrproject/zephyr/soc/renesas/rz/Kconfig"
osource "/home/barth/zephyrproject/zephyr/soc/renesas/rx/Kconfig"
osource "/home/barth/zephyrproject/zephyr/soc/renesas/rcar/Kconfig"
osource "/home/barth/zephyrproject/zephyr/soc/renesas/ra/Kconfig"
osource "/home/barth/zephyrproject/zephyr/soc/realtek/ec/Kconfig"
osource "/home/barth/zephyrproject/zephyr/soc/raspberrypi/rpi_pico/Kconfig"
osource "/home/barth/zephyrproject/zephyr/soc/quicklogic/eos_s3/Kconfig"
osource "/home/barth/zephyrproject/zephyr/soc/qemu/virt_riscv/Kconfig"
osource "/home/barth/zephyrproject/zephyr/soc/qemu/malta/Kconfig"
osource "/home/barth/zephyrproject/zephyr/soc/openisa/rv32m1/Kconfig"
osource "/home/barth/zephyrproject/zephyr/soc/openhwgroup/cva6/Kconfig"
osource "/home/barth/zephyrproject/zephyr/soc/oct/osd32mp15x/Kconfig"
osource "/home/barth/zephyrproject/zephyr/soc/nxp/s32/Kconfig"
osource "/home/barth/zephyrproject/zephyr/soc/nxp/rw/Kconfig"
osource "/home/barth/zephyrproject/zephyr/soc/nxp/mcx/Kconfig"
osource "/home/barth/zephyrproject/zephyr/soc/nxp/lpc/Kconfig"
osource "/home/barth/zephyrproject/zephyr/soc/nxp/layerscape/Kconfig"
osource "/home/barth/zephyrproject/zephyr/soc/nxp/kinetis/Kconfig"
osource "/home/barth/zephyrproject/zephyr/soc/nxp/imxrt/Kconfig"
osource "/home/barth/zephyrproject/zephyr/soc/nxp/imx/Kconfig"
osource "/home/barth/zephyrproject/zephyr/soc/nuvoton/numicro/Kconfig"
osource "/home/barth/zephyrproject/zephyr/soc/nuvoton/numaker/Kconfig"
osource "/home/barth/zephyrproject/zephyr/soc/nuvoton/npcx/Kconfig"
osource "/home/barth/zephyrproject/zephyr/soc/nuvoton/npcm/Kconfig"
osource "/home/barth/zephyrproject/zephyr/soc/nordic/Kconfig"
osource "/home/barth/zephyrproject/zephyr/soc/neorv32/Kconfig"
osource "/home/barth/zephyrproject/zephyr/soc/native/inf_clock/Kconfig"
osource "/home/barth/zephyrproject/zephyr/soc/microchip/sam/sama7/Kconfig"
osource "/home/barth/zephyrproject/zephyr/soc/microchip/sam/sam_d5x_e5x/Kconfig"
osource "/home/barth/zephyrproject/zephyr/soc/microchip/pic32c/pic32cz_ca/Kconfig"
osource "/home/barth/zephyrproject/zephyr/soc/microchip/pic32c/pic32cx_sg/Kconfig"
osource "/home/barth/zephyrproject/zephyr/soc/microchip/pic32c/pic32cm_jh/Kconfig"
osource "/home/barth/zephyrproject/zephyr/soc/microchip/miv/Kconfig"
osource "/home/barth/zephyrproject/zephyr/soc/microchip/mec/Kconfig"
osource "/home/barth/zephyrproject/zephyr/soc/mediatek/mt8xxx/Kconfig"
osource "/home/barth/zephyrproject/zephyr/soc/lowrisc/opentitan/Kconfig"
osource "/home/barth/zephyrproject/zephyr/soc/litex/litex_vexriscv/Kconfig"
osource "/home/barth/zephyrproject/zephyr/soc/ite/ec/Kconfig"
osource "/home/barth/zephyrproject/zephyr/soc/intel/wildcat_lake/Kconfig"
osource "/home/barth/zephyrproject/zephyr/soc/intel/raptor_lake/Kconfig"
osource "/home/barth/zephyrproject/zephyr/soc/intel/panther_lake/Kconfig"
osource "/home/barth/zephyrproject/zephyr/soc/intel/lakemont/Kconfig"
osource "/home/barth/zephyrproject/zephyr/soc/intel/intel_socfpga_std/Kconfig"
osource "/home/barth/zephyrproject/zephyr/soc/intel/intel_socfpga/Kconfig"
osource "/home/barth/zephyrproject/zephyr/soc/intel/intel_niosv/Kconfig"
osource "/home/barth/zephyrproject/zephyr/soc/intel/intel_ish/Kconfig"
osource "/home/barth/zephyrproject/zephyr/soc/intel/intel_adsp/Kconfig"
osource "/home/barth/zephyrproject/zephyr/soc/intel/elkhart_lake/Kconfig"
osource "/home/barth/zephyrproject/zephyr/soc/intel/atom/Kconfig"
osource "/home/barth/zephyrproject/zephyr/soc/intel/apollo_lake/Kconfig"
osource "/home/barth/zephyrproject/zephyr/soc/intel/alder_lake/Kconfig"
osource "/home/barth/zephyrproject/zephyr/soc/infineon/edge/Kconfig"
osource "/home/barth/zephyrproject/zephyr/soc/infineon/cat3/Kconfig"
osource "/home/barth/zephyrproject/zephyr/soc/infineon/cat1c/Kconfig"
osource "/home/barth/zephyrproject/zephyr/soc/infineon/cat1b/Kconfig"
osource "/home/barth/zephyrproject/zephyr/soc/infineon/cat1a/Kconfig"
osource "/home/barth/zephyrproject/zephyr/soc/gd/gd32/Kconfig"
osource "/home/barth/zephyrproject/zephyr/soc/gaisler/leon3/Kconfig"
osource "/home/barth/zephyrproject/zephyr/soc/gaisler/gr716a/Kconfig"
osource "/home/barth/zephyrproject/zephyr/soc/espressif/Kconfig"
osource "/home/barth/zephyrproject/zephyr/soc/ene/kb1200/Kconfig"
osource "/home/barth/zephyrproject/zephyr/soc/ene/kb106x/Kconfig"
osource "/home/barth/zephyrproject/zephyr/soc/egis/Kconfig"
osource "/home/barth/zephyrproject/zephyr/soc/efinix/sapphire/Kconfig"
osource "/home/barth/zephyrproject/zephyr/soc/cdns/xtensa_sample_controller/Kconfig"
osource "/home/barth/zephyrproject/zephyr/soc/cdns/sample_controller32/Kconfig"
osource "/home/barth/zephyrproject/zephyr/soc/cdns/dc233c/Kconfig"
osource "/home/barth/zephyrproject/zephyr/soc/brcm/bcmvk/Kconfig"
osource "/home/barth/zephyrproject/zephyr/soc/brcm/bcm2712/Kconfig"
osource "/home/barth/zephyrproject/zephyr/soc/brcm/bcm2711/Kconfig"
osource "/home/barth/zephyrproject/zephyr/soc/bflb/Kconfig"
osource "/home/barth/zephyrproject/zephyr/soc/atmel/sam0/Kconfig"
osource "/home/barth/zephyrproject/zephyr/soc/atmel/sam/Kconfig"
osource "/home/barth/zephyrproject/zephyr/soc/aspeed/Kconfig"
osource "/home/barth/zephyrproject/zephyr/soc/arm/Kconfig"
osource "/home/barth/zephyrproject/zephyr/soc/arm/beetle/Kconfig"
osource "/home/barth/zephyrproject/zephyr/soc/antmicro/myra/Kconfig"
osource "/home/barth/zephyrproject/zephyr/soc/andestech/Kconfig"
osource "/home/barth/zephyrproject/zephyr/soc/amd/acp_6_0/Kconfig"
osource "/home/barth/zephyrproject/zephyr/soc/ambiq/Kconfig"
osource "/home/barth/zephyrproject/zephyr/soc/aesc/Kconfig"
osource "/home/barth/zephyrproject/zephyr/soc/adi/max32/Kconfig"
```
